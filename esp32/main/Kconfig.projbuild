## esp32/main/Kconfig.projbuild
```kconfig
menu "忆录录音笔"

    menu "网络与账号"

        config RECALL_WIFI_SSID
            string "WiFi 名称 (SSID)"
            default ""
            help
                只支持 2.4GHz。留空则开机后一直等配网（见 README「没有 WiFi 怎么办」）。

        config RECALL_WIFI_PASSWORD
            string "WiFi 密码"
            default ""

        config RECALL_SERVER_URL
            string "服务端地址（出厂默认值）"
            default "http://192.168.1.10:8787"
            help
                填电脑的局域网 IP 和端口，不要带结尾斜杠。
                ESP32 跑 TLS 很吃内存，内网直接 http 即可。
                现场配网（Recall-XXXXXX 热点页面）里也能改，改完存 NVS，
                优先级高于这里的默认值——换服务器不用重新烧固件。

        config RECALL_DEVICE_NAME
            string "设备名"
            default "recall-mic"
            help
                会作为配对时上报的名字，后台可以改成中文。

        config RECALL_PROV_AP_PASSWORD
            string "配网热点密码（至少 8 位，留空=开放热点）"
            default ""
            help
                配网时设备会开一个名为 Recall-XXXXXX 的热点（XXXXXX 是设备编号）。
                留空即开放热点，手机连上就能开 http://192.168.4.1 配网。
                填了密码则至少 8 位（WPA2 限制）。

        config RECALL_PROV_TIMEOUT_S
            int "配网等待时间 (秒)"
            default 180
            range 30 900
            help
                进配网后等多久没人操作就自动退出。

    endmenu

    menu "硬件"

        choice RECALL_BOARD
            prompt "开发板"
            default RECALL_BOARD_WS_EPAPER_154

            config RECALL_BOARD_WS_EPAPER_154
                bool "微雪 ESP32-S3-ePaper-1.54（200x200 墨水屏 + ES8311）"
                depends on IDF_TARGET_ESP32S3
                help
                    板载 1.54 寸 200x200 单色电子墨水屏（SPI）、ES8311 编解码芯片
                    （录音+播放一颗搞定，必须给 MCLK）、BOOT(GPIO0) 和 PWR(GPIO18) 两个按键。
                    墨水屏刷新慢但断电后画面保留，非常适合长时间待机的录音笔。
                    引脚取自官方示例仓库 02_Example/ESP-IDF/V2/08_Audio_Test。

            config RECALL_BOARD_BOX0
                bool "正点原子 ATK-DNESP32S3 BOX0（240x240 ST7789 + ES8311）"
                depends on IDF_TARGET_ESP32S3
                help
                    小智 AI 语音机器人同款硬件：1.54 寸 240x240 方屏、
                    ES8311 一颗芯片管录音和播放、三个实体按键（R=GPIO0）。

            config RECALL_BOARD_GENERIC
                bool "通用（S3 DevKitC-1 / C3 SuperMini + INMP441 数字麦）"
                help
                    自己接线的最小系统板：I2S 数字麦克风 + 一个按键 + 可选 OLED。

            config RECALL_BOARD_BOX3
                bool "正点原子 DNESP32S3 BOX3（320x240 ST7789 + ES7210）"
                depends on IDF_TARGET_ESP32S3
                help
                    ATK-DNESP32S3B3：2.4 寸 ST7789V2 320x240 SPI 屏、
                    ES7210 采集 + ES8311 输出、AW9523B 扩展 IO。

        endchoice

        choice RECALL_DISPLAY_TYPE
            prompt "屏幕类型"
            default RECALL_DISPLAY_EPAPER_154 if RECALL_BOARD_WS_EPAPER_154
            default RECALL_DISPLAY_ST7789 if RECALL_BOARD_BOX0
            default RECALL_DISPLAY_ST7789 if RECALL_BOARD_BOX3
            default RECALL_DISPLAY_AUTO

            config RECALL_DISPLAY_AUTO
                bool "自动（先探 I2C 上有没有 OLED，没有就当无屏）"
                help
                    上电后在 I2C 上找 0x3C / 0x3D 的 SSD1306，
                    找到就驱动它，找不到就按无屏跑（LED + 蜂鸣器）。
                    接的是 SPI 的 ST7735 就用下面那个选项，探不出来。

            config RECALL_DISPLAY_NONE
                bool "无屏幕（LED + 蜂鸣器反馈）"

            config RECALL_DISPLAY_SSD1306
                bool "SSD1306 OLED 128x64（I2C）"

            config RECALL_DISPLAY_ST7735
                bool "ST7735 TFT 160x80（SPI）"

            config RECALL_DISPLAY_ST7789
                bool "ST7789 彩色屏（SPI，分辨率跟板级走）"

            config RECALL_DISPLAY_EPAPER_154
                bool "电子墨水屏 1.54 寸 200x200（SPI，单色）"
                help
                    刷新一次要几百毫秒，所以刷新放在后台任务里做，主循环不等待。
                    录音计时按 10 秒量化显示，电平条和闪烁点不画（实时反馈看 LED）。

        endchoice

        config RECALL_LCD_PCLK_MHZ
            int "彩色屏 SPI 时钟 (MHz)"
            depends on RECALL_DISPLAY_ST7789
            range 10 80
            default 40
            help
                40MHz 刷整屏约 20ms，够用且稳。花屏就把这里降到 26。

        config RECALL_LCD_ROTATION
            int "彩色屏方向 (0=默认 1=转90度 2=转270度 3=转180度)"
            depends on RECALL_DISPLAY_ST7789
            range 0 3
            default 0
            help
                方屏（240x240）保持 0 就行；320x240 横屏用 1。
                画面上下颠倒或镜像时改这里，不用动代码。

        config RECALL_SD_ENABLE
            bool "用 TF 卡存录音（不插卡自动退回片内 Flash）"
            default n
            help
                打开后启动时先尝试挂载 TF 卡：挂上了就用卡存；没插卡、卡不是 FAT32
                或者引脚填错，都会自动退回片内 LittleFS（约 5MB / 55 分钟纯语音），
                录音和上传流程完全不受影响。

                用途：出门一整天没法上传时，片内 5MB 只能存两小时出头，
                插 32GB 卡可以存几个月。回家连上 WiFi 再补传。

                卡要格式化成 FAT32。这块板子的 TF 槽是 **SDMMC 1-bit**
                （CLK/CMD/D0 三根线，没有 CS），不是 SPI。

                微雪 ESP32-S3-Touch-ePaper-1.54 原理图实测：
                  CLK=GPIO39  CMD=GPIO41  D0=GPIO40（SD_CS / CD 未连接）

        config RECALL_SD_CLK
            int "TF 卡 CLK (GPIO)"
            depends on RECALL_SD_ENABLE
            range -1 53
            default -1

        config RECALL_SD_CMD
            int "TF 卡 CMD (GPIO)"
            depends on RECALL_SD_ENABLE
            range -1 53
            default -1

        config RECALL_SD_D0
            int "TF 卡 D0 / DAT0 (GPIO)"
            depends on RECALL_SD_ENABLE
            range -1 53
            default -1

    endmenu

    menu "录音"

        config RECALL_OPUS_BITRATE
            int "Opus 码率 (bps)"
            range 6000 32000
            default 12000
            help
                12kbps 单声道 16kHz 是语音笔记的甜点：1 分钟约 90KB，
                比 64kbps 的 WAV/ADPCM 小 5 倍，识别准确率几乎无损。
                环境嘈杂或多人讨论可以调到 16000~20000。

        config RECALL_OPUS_COMPLEXITY
            int "Opus 编码复杂度 (0-10)"
            range 0 10
            default 2
            help
                复杂度越高越费电。C3 建议 1~2，S3 可以用 3~5。

        config RECALL_MIN_VOICED_MS
            int "最短有效语音 (ms)"
            default 3000
            range 500 60000
            help
                一次录音里"真正有人说话"的累计时长低于这个值，
                就不上传、直接删掉本地文件。

        config RECALL_AUTO_SESSION
            bool "无人按键时由 VAD 自动开录"
            default n
            help
                打开后设备常驻监听，检测到说话自动开始录音，
                静音超过 RECALL_AUTO_STOP_MS 自动结束。
                这样会把功耗从 ~10uA 提到 ~18mA，电池供电时慎用。

        config RECALL_AUTO_STOP_MS
            int "自动结束的静音时长 (ms)"
            depends on RECALL_AUTO_SESSION
            default 8000
            range 2000 120000

        config RECALL_ALWAYS_ON
            bool "常驻监听：开机就守麦，有人声才落盘"
            default n
            help
                打开后设备不再「按一下录一次」，而是常驻监听：
                检测到人声自动开录，静音超过 RECALL_SILENCE_SPLIT_MS
                就收尾、把已录文件上传、清空本地暂存，然后继续守麦。
                这个模式不深睡（否则就没法守麦），待机电流约 18~25mA。

        config RECALL_SILENCE_SPLIT_MS
            int "常驻模式：静音多久算一段说完 (ms)"
            depends on RECALL_ALWAYS_ON
            default 60000
            range 10000 600000
            help
                静音超过这个时长就收尾：上传已录文件、清空本地暂存，
                然后回到监听。太短会把正常停顿切成两条，太长会让
                Flash 里堆更多音频（15 秒一片，60 秒约 4 片 / 90KB 左右）。

        config RECALL_QUIET_SCREEN
            bool "常驻监听/录音时不刷新屏幕（省电）"
            depends on RECALL_ALWAYS_ON
            default y
            help
                墨水屏刷一次要几百毫秒、整屏闪一下。打开后只在状态切换
                时画一帧，录音计时和电平不再更新。

    endmenu

    menu "省电"

        config RECALL_IDLE_SLEEP_S
            int "空闲多少秒后深睡 (0=不深睡)"
            default 300
            range 0 3600
            help
                没在录音也没有待上传文件时，超过这个时间就进深睡，
                电流从 ~18mA 降到 ~10uA，按一下按键唤醒。
                0 表示永不深睡（调试时用）。

        config RECALL_PERIODIC_UPLOAD_S
            int "定时补传间隔（秒，0=关闭）"
            default 0
            range 0 86400
            help
                有积压录音时，最多等这么久就主动开一次 WiFi 补传，并让服务端收尾
                （生成转写和纪要）。4 小时 = 14400。
                设为 0 则只在「存储快满 / 双击 BOOT / 开机」时才传。

        config RECALL_UPLOAD_RETRY
            int "上传失败重试次数"
            default 3
            range 1 10

        config RECALL_CLOSE_AFTER_UPLOAD
            bool "上传后立即收尾（马上出转写和纪要）"
            default y
            help
                关闭后由服务端在静默超时（默认 180 秒）时自动收尾，
                适合"一整天连续记录、最后统一整理"的用法。

    endmenu

endmenu
```

## esp32/sdkconfig.defaults
```kconfig
# ---------------------------------------------------------------------------
# 通用默认配置（S3 / C3 共用）
# 功耗相关的开关都在这里，改之前先看 README 的「省电」一节
# ---------------------------------------------------------------------------

# 分区表：默认按 8MB Flash。4MB 板子改用 sdkconfig.defaults.esp32c3 里的 4MB 表
CONFIG_PARTITION_TABLE_CUSTOM=y
CONFIG_PARTITION_TABLE_CUSTOM_FILENAME="partitions_8mb.csv"
CONFIG_PARTITION_TABLE_OFFSET=0x8000

# CPU：平时 80MHz，录音/编码时拉到 160MHz（DFS）
CONFIG_ESP_DEFAULT_CPU_FREQ_MHZ=160
CONFIG_ESP_DEFAULT_CPU_FREQ_MHZ_160=y

# 电源管理：动态调频 + tickless 空闲
CONFIG_PM_ENABLE=y
CONFIG_FREERTOS_USE_TICKLESS_IDLE=y
CONFIG_FREERTOS_HZ=1000

# light sleep 时给 Flash 断电，S3 上实测能省 1.5~2mA（见 README）
CONFIG_ESP_SLEEP_POWER_DOWN_FLASH=y

# 体积/性能：音频编码吃 CPU，用 -O2
CONFIG_COMPILER_OPTIMIZATION_PERF=y
CONFIG_COMPILER_OPTIMIZATION_ASSERTION_LEVEL=1

# 日志：默认 INFO，现场排查够用
CONFIG_LOG_DEFAULT_LEVEL_INFO=y
CONFIG_LOG_COLORS=y

# 任务看门狗放宽：Opus 编码 + LittleFS 写盘会短暂占住 CPU
CONFIG_ESP_TASK_WDT_TIMEOUT_S=30
CONFIG_ESP_TASK_WDT_CHECK_IDLE_TASK_CPU1=n

# 网络
CONFIG_LWIP_MAX_SOCKETS=8
CONFIG_ESP_WIFI_STATIC_RX_BUFFER_NUM=6
CONFIG_ESP_WIFI_DYNAMIC_RX_BUFFER_NUM=16
CONFIG_ESP_WIFI_DYNAMIC_TX_BUFFER_NUM=16
CONFIG_LWIP_TCP_MSS=1440

# 蓝牙用不上，关掉省 Flash 和 RAM（C3/S3 也是默认关，这里显式写明）
CONFIG_BT_ENABLED=n

# LittleFS：分区名和挂载点在代码里指定，这里只把擦除块调到 4KB
CONFIG_LITTLEFS_READ_SIZE=128
CONFIG_LITTLEFS_WRITE_SIZE=128
```
